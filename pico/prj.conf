## CMakeLists.txt
```
cmake_minimum_required(VERSION 3.20.5)

find_package(Zephyr REQUIRED HINTS $ENV{ZEPHYR_BASE})
project(veggie-tower)

target_sources(app PRIVATE
    src/main.c
    src/wifi.c
    src/mqtt.c
    src/i2c.c
    src/sensors.c
    src/settings.c
    src/watering.c
)
```

## prj.conf
```kconfig
# WiFi
CONFIG_WIFI=y
CONFIG_NET_L2_WIFI_MGMT=y

# Networking
CONFIG_NETWORKING=y
CONFIG_NET_IPV4=y
CONFIG_NET_TCP=y
CONFIG_NET_SOCKETS=y
CONFIG_NET_SOCKETS_POSIX_NAMES=y
CONFIG_DNS_RESOLVER=y

# MQTT
CONFIG_MQTT_LIB=y

# I2C
CONFIG_I2C=y

# Sensors
CONFIG_SENSOR=y

# Settings (setpoint persistence)
CONFIG_SETTINGS=y
CONFIG_SETTINGS_NVS=y
CONFIG_NVS=y

# Logging
CONFIG_LOG=y
CONFIG_LOG_DEFAULT_LEVEL=3

# System
CONFIG_MAIN_STACK_SIZE=4096
CONFIG_HEAP_MEM_POOL_SIZE=16384
```

## src/main.c
```c
#include <zephyr/kernel.h>
#include <zephyr/logging/log.h>

#include "wifi.h"
#include "mqtt.h"
#include "i2c.h"
#include "sensors.h"
#include "settings.h"
#include "watering.h"

LOG_MODULE_REGISTER(main, LOG_LEVEL_INF);

int main(void)
{
    LOG_INF("Veggie Tower starting up");

    /* Load persisted setpoints from flash */
    settings_load();

    /* Initialize WiFi and wait for connection */
    wifi_init();

    /* Initialize MQTT and connect to broker */
    mqtt_init();

    /* Initialize I2C bus for zone controller communication */
    i2c_init();

    /* Initialize onboard sensors */
    sensors_init();

    /* Publish current setpoints to Home Assistant to resync state */
    mqtt_publish_setpoints();

    /* Main loop */
    while (1) {
        sensors_update();
        i2c_poll_zones();
        watering_update();
        mqtt_process();
        k_sleep(K_SECONDS(1));
    }

    return 0;
}
```

## src/i2c.c
```c
#include <zephyr/kernel.h>
#include <zephyr/logging/log.h>
#include "i2c.h"

LOG_MODULE_REGISTER(i2c, LOG_LEVEL_INF);

int i2c_init(void)
{
    /* TODO: initialize I2C bus */
    return 0;
}

int i2c_poll_zones(void)
{
    /* TODO: poll each zone controller for sensor data */
    /* TODO: forward received data to mqtt telemetry */
    return 0;
}
```

## src/i2c.h
```c
#ifndef I2C_H
#define I2C_H

#define ZONE_COUNT 3
#define ZONE_1_ADDR 0x10
#define ZONE_2_ADDR 0x11
#define ZONE_3_ADDR 0x12

int i2c_init(void);
int i2c_poll_zones(void);

#endif /* I2C_H */
```

## src/mqtt.c
```c
#include <zephyr/kernel.h>
#include <zephyr/logging/log.h>
#include "mqtt.h"

LOG_MODULE_REGISTER(mqtt, LOG_LEVEL_INF);

int mqtt_init(void)
{
    /* TODO: connect to broker using credentials from prj.conf */
    /* TODO: subscribe to setpoint topics */
    return 0;
}

int mqtt_process(void)
{
    /* TODO: handle incoming setpoint messages */
    /* TODO: publish queued telemetry */
    return 0;
}

int mqtt_publish_setpoints(void)
{
    /* TODO: publish current setpoints for all zones to resync HA state */
    return 0;
}

int mqtt_publish_telemetry(const char *topic, const char *payload)
{
    /* TODO: publish a telemetry message */
    return 0;
}
```

## src/mqtt.h
```c
#ifndef MQTT_H
#define MQTT_H

int mqtt_init(void);
int mqtt_process(void);
int mqtt_publish_setpoints(void);
int mqtt_publish_telemetry(const char *topic, const char *payload);

#endif /* MQTT_H */
```

## src/sensors.c
```c
#include <zephyr/kernel.h>
#include <zephyr/logging/log.h>
#include "sensors.h"

LOG_MODULE_REGISTER(sensors, LOG_LEVEL_INF);

static struct pico_sensor_data sensor_data;

int sensors_init(void)
{
    /* TODO: initialize onboard temp/humidity/pressure/CO2 sensors */
    return 0;
}

int sensors_update(void)
{
    /* TODO: read and update sensor_data */
    return 0;
}

const struct pico_sensor_data *sensors_get(void)
{
    return &sensor_data;
}
```

## src/sensors.h
```c
#ifndef SENSORS_H
#define SENSORS_H

struct pico_sensor_data {
    double temperature;
    double humidity;
    double pressure;
    double co2;
};

int sensors_init(void);
int sensors_update(void);
const struct pico_sensor_data *sensors_get(void);

#endif /* SENSORS_H */
```

## src/settings.c
```c
#include <zephyr/kernel.h>
#include <zephyr/logging/log.h>
#include <zephyr/settings/settings.h>
#include "settings.h"

LOG_MODULE_REGISTER(settings, LOG_LEVEL_INF);

static struct zone_setpoints zone_setpoints[ZONE_COUNT];

int settings_load(void)
{
    /* TODO: load setpoints from NVS flash */
    return 0;
}

int settings_save(void)
{
    /* TODO: persist setpoints to NVS flash */
    return 0;
}

const struct zone_setpoints *settings_get_zone(uint8_t zone)
{
    return &zone_setpoints[zone];
}

int settings_set_zone(uint8_t zone, const struct zone_setpoints *setpoints)
{
    zone_setpoints[zone] = *setpoints;
    return settings_save();
}
```

## src/settings.h
```c
#ifndef SETTINGS_H
#define SETTINGS_H

#define SUBZONE_COUNT 4

struct subzone_setpoints {
    uint32_t moisture_low;
    uint32_t moisture_target;
    uint32_t watering_duration;
    uint32_t watering_settle_time;
    uint32_t watering_max_cycles;
    uint8_t  sensor_map[SUBZONE_COUNT]; /* which analog sensor belongs to this subzone */
};

struct zone_setpoints {
    struct subzone_setpoints subzones[SUBZONE_COUNT];
    uint8_t  fan_speed;        /* 0-100% */
    uint8_t  light_on_hour;
    uint8_t  light_on_minute;
    uint8_t  light_off_hour;
    uint8_t  light_off_minute;
    uint32_t co2_threshold;
    uint32_t temp_threshold;
};

int settings_load(void);
int settings_save(void);
const struct zone_setpoints *settings_get_zone(uint8_t zone);
int settings_set_zone(uint8_t zone, const struct zone_setpoints *setpoints);

#endif /* SETTINGS_H */
```

## src/watering.c
```c
#include <zephyr/kernel.h>
#include <zephyr/logging/log.h>
#include "watering.h"
#include "settings.h"
#include "i2c.h"
#include "mqtt.h"

LOG_MODULE_REGISTER(watering, LOG_LEVEL_INF);

int watering_update(void)
{
    /*
     * TODO: per zone, per subzone:
     * 1. Check averaged soil moisture
     * 2. If below moisture_low, begin watering cycle:
     *    a. Command valve open for watering_duration seconds via I2C
     *    b. Wait watering_settle_time seconds
     *    c. Re-check moisture
     *    d. If below moisture_target, recalculate duration and repeat
     *    e. Repeat up to watering_max_cycles, then alert HA if target not reached
     */
    return 0;
}
```

## src/watering.h
```c
#ifndef WATERING_H
#define WATERING_H

int watering_update(void);

#endif /* WATERING_H */
```

## src/wifi.c
```c
#include <zephyr/kernel.h>
#include <zephyr/logging/log.h>
#include "wifi.h"

LOG_MODULE_REGISTER(wifi, LOG_LEVEL_INF);

int wifi_init(void)
{
    /* TODO: implement WiFi connection using credentials from prj.conf */
    return 0;
}

bool wifi_is_connected(void)
{
    /* TODO: return actual connection status */
    return false;
}
```

## src/wifi.h
```c
#ifndef WIFI_H
#define WIFI_H

int wifi_init(void);
bool wifi_is_connected(void);

#endif /* WIFI_H */
```
